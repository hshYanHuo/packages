## peripherals/my_at_device/Kconfig
```kconfig
menu "RT-Thread packages add by yanhuo "

menuconfig PKG_USING_MY_AT_DEVICE
    bool "MY AT DEVICE: RT-Thread AT component porting or samples for different device"
    default n

if PKG_USING_MY_AT_DEVICE

    config PKG_MY_AT_DEVICE_PATH
        string
        default "/packages/peripherals/my_at_device"

    if PKG_MY_AT_DEVICE_VER_NUM >= 0x20000

        source "$PKGS_DIR/packages/peripherals/my_at_device/sim7600ce/Kconfig"

    endif

    if PKG_MY_AT_DEVICE_VER_NUM < 0x20000

    endif

    choice

            prompt "Version"
            default PKG_USING_MY_AT_DEVICE_LATEST_VERSION if (RT_VER_NUM >= 0x40004)

            help
                Select the my_at_device version

            if (AT_SW_VERSION_NUM >= 0x10300)

                config PKG_USING_MY_AT_DEVICE_V210
                    bool "v2.1.0"

            endif


            config PKG_USING_MY_AT_DEVICE_LATEST_VERSION
                bool "latest"

        endchoice

        config PKG_MY_AT_DEVICE_VER
            string
            default "latest"    if PKG_USING_MY_AT_DEVICE_LATEST_VERSION
            default "v2.1.0"    if PKG_USING_MY_AT_DEVICE_V210


        config PKG_MY_AT_DEVICE_VER_NUM
            hex
            default 0x99999    if PKG_USING_MY_AT_DEVICE_LATEST_VERSION
            default 0x20100    if PKG_USING_MY_AT_DEVICE_V210

    endif


endmenu
```

## peripherals/my_at_device/sim7600ce/Kconfig
```kconfig
# SIM76XX AT device configuration
menuconfig AT_DEVICE_USING_SIM7600CE
    bool "SIMCom SIM7600CE"
    default n

if AT_DEVICE_USING_SIM7600CE

    config AT_DEVICE_SIM7600CE_INIT_ASYN
        bool "Enable initialize by thread"
        default n

    config AT_DEVICE_SIM7600CE_SOCKET
        bool "Enable SIM7600CE at socket"
        select AT_USING_SOCKET
        default y

    config AT_DEVICE_SIM7600CE_SAMPLE
        bool "Enable sample"
        default y

    if AT_DEVICE_SIM7600CE_SAMPLE

        config SIM7600CE_SAMPLE_POWER_PIN
            int "Power pin"
            default -1

        config SIM7600CE_SAMPLE_STATUS_PIN
            int "Power status pin"
            default -1

        config SIM7600CE_SAMPLE_CLIENT_NAME
            string "AT client device name"
            default "uart2"

        config SIM7600CE_SAMPLE_RECV_BUFF_LEN
            int "The maximum length of receive line buffer"
            default 512

    endif

endif
```
